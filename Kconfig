## Kconfig
```kconfig
# SPDX-License-Identifier: GPL-2.0

menu "GXP device"

config GXP
	tristate "Device driver for GXP"
	default m
	select GENERIC_ALLOCATOR
	help
	  This driver supports the GXP device. Say Y if you want to
	  include this driver in the kernel.

	  To compile this driver as a module, choose M here. The module will be
	  called "gxp".

choice GXP_PLATFORM
	bool "Target platform to build GXP driver for"
	depends on GXP
	default GXP_CLOUDRIPPER

config GXP_CLOUDRIPPER
	bool "Build for Cloudripper development board"
	help
	  Select this to build for the Cloudripper development board.

config GXP_ZEBU
	bool "Build for ZeBu emulation system"
	help
	  Select this to build for the full-SoC ZeBu emulation platform.

config GXP_IP_ZEBU
	bool "Build for an IP-ZeBu emulation system"
	help
	  Select this to build for the Aurora IP-ZeBu emulation platform.

endchoice

endmenu
```
